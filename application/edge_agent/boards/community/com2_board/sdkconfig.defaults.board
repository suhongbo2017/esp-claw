## standalone_lcd_test/sdkconfig.defaults
```kconfig
; Standalone ST7735S LCD Test Firmware Configuration

; CPU configuration
CONFIG_ESP_DEFAULT_CPU_FREQ_MHZ_240=y

; Flash configuration
CONFIG_SPI_FLASH_WIPE_NOT_SUPPORTED=y
CONFIG_PARTITION_TABLE_TWO_APP=y

; Log output
CONFIG_LOG_DEFAULT_LEVEL_INFO=y
CONFIG_LOG_MAXIMUM_LEVEL_INFO=y

; FreeRTOS
CONFIG_FREERTOS_HZ=1000
```
